## Proyecto/audio_motores/code/main/Kconfig.projbuild
```kconfig
menu "Robot sumo audio motor controller"

    config AUDIO_MOTOR_LEFT_ENABLE_GPIO
        int "L298N ENA GPIO"
        default 15

    config AUDIO_MOTOR_LEFT_IN1_GPIO
        int "L298N IN1 GPIO"
        default 4

    config AUDIO_MOTOR_LEFT_IN2_GPIO
        int "L298N IN2 GPIO"
        default 5

    config AUDIO_MOTOR_RIGHT_IN1_GPIO
        int "L298N IN3 GPIO"
        default 6

    config AUDIO_MOTOR_RIGHT_IN2_GPIO
        int "L298N IN4 GPIO"
        default 7

    config AUDIO_MOTOR_RIGHT_ENABLE_GPIO
        int "L298N ENB GPIO"
        default 16

    config AUDIO_MIC_ADC_CHANNEL
        int "ADC1 channel for analog microphone"
        default 0
        help
            ESP32-S3 GPIO1 is ADC1_CH0. Use an analog microphone output.

    config AUDIO_MOTOR_DEFAULT_SPEED
        int "Default motor speed percent"
        default 65
        range 30 100

    config AUDIO_MOTOR_TURN_SPEED
        int "Turn motor speed percent"
        default 70
        range 30 100

    config AUDIO_MOTOR_RETREAT_SPEED
        int "Retreat motor speed percent"
        default 70
        range 30 100

    config AUDIO_CLAP_MIN_DELTA
        int "Minimum clap delta"
        default 260
        range 80 1600
        help
            Minimum absolute ADC deviation from the noise baseline needed to
            accept a clap candidate. Lower values are more sensitive.

    config AUDIO_LEFT_TURN_MS
        int "One-clap left turn duration ms"
        default 800

    config AUDIO_RETREAT_REVERSE_MS
        int "Two-clap reverse duration ms"
        default 1200

    config AUDIO_RETREAT_TURN_MS
        int "Two-clap turn duration ms"
        default 650

endmenu
```

## Proyecto/cam_identificador/code/sdkconfig.defaults
```kconfig
CONFIG_CAMERA_MODULE_AI_THINKER=y
CONFIG_ESPTOOLPY_FLASHSIZE_4MB=y
CONFIG_SPIRAM=y
CONFIG_SPIRAM_MODE_QUAD=y
CONFIG_SPIRAM_USE_CAPS_ALLOC=y
```

## Proyecto/dataset_capture/firmware/sdkconfig.defaults
```kconfig
CONFIG_ESPTOOLPY_FLASHSIZE_4MB=y
CONFIG_SPIRAM=y
CONFIG_SPIRAM_MODE_QUAD=y
CONFIG_SPIRAM_USE_CAPS_ALLOC=y
CONFIG_ESPTOOLPY_MONITOR_BAUD=115200
```

## Proyecto/habilitacion_dummy/code/main/Kconfig.projbuild
```kconfig
menu "Dummy qualification controller"

    config DUMMY_MOTOR_LEFT_ENABLE_GPIO
        int "L298N ENA GPIO"
        default 15

    config DUMMY_MOTOR_LEFT_IN1_GPIO
        int "L298N IN1 GPIO"
        default 4

    config DUMMY_MOTOR_LEFT_IN2_GPIO
        int "L298N IN2 GPIO"
        default 5

    config DUMMY_MOTOR_RIGHT_IN1_GPIO
        int "L298N IN3 GPIO"
        default 6

    config DUMMY_MOTOR_RIGHT_IN2_GPIO
        int "L298N IN4 GPIO"
        default 7

    config DUMMY_MOTOR_RIGHT_ENABLE_GPIO
        int "L298N ENB GPIO"
        default 16

    config DUMMY_IDENTIFIER_RX_GPIO
        int "ESP32-S3 RX GPIO for identifier camera UART"
        default 17

    config DUMMY_EDGE_RX_GPIO
        int "ESP32-S3 RX GPIO for edge camera UART"
        default 18

    config DUMMY_UART_BAUD
        int "Camera UART baud rate"
        default 115200

    config DUMMY_ATTACK_SPEED
        int "Forward attack speed percent"
        default 72
        range 30 100

    config DUMMY_SEARCH_SPEED
        int "Search turn speed percent"
        default 55
        range 25 100

    config DUMMY_ALIGN_SPEED
        int "Identifier alignment turn speed percent"
        default 62
        range 25 100

    config DUMMY_AVOID_SPEED
        int "Edge avoidance speed percent"
        default 72
        range 30 100

    config DUMMY_IDENTIFIER_STALE_MS
        int "Identifier telemetry stale time ms"
        default 700
        range 100 5000

    config DUMMY_EDGE_STALE_MS
        int "Edge telemetry stale time ms"
        default 450
        range 50 3000

    config DUMMY_REVERSE_MS
        int "Reverse duration when center edge is detected"
        default 520
        range 100 3000

    config DUMMY_EDGE_TURN_MS
        int "Turn duration when side edge is detected"
        default 420
        range 100 3000

endmenu
```

## Proyecto/habilitacion_dummy/code/sdkconfig.defaults
```kconfig
CONFIG_ESPTOOLPY_FLASHSIZE_4MB=y
CONFIG_ESPTOOLPY_MONITOR_BAUD=115200
CONFIG_FREERTOS_HZ=1000
```
